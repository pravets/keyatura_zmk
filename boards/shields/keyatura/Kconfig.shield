## boards/shields/keyatura/Kconfig.shield
```kconfig
config SHIELD_KEYATURA_DON
    def_bool $(shields_list_contains,keyatura_don)

config SHIELD_KEYATURA_MOUSE
    def_bool $(shields_list_contains,keyatura_mouse)
```

## config/west.yml
```yaml
manifest:
  remotes:
    - name: zmkfirmware
      url-base: https://github.com/zmkfirmware
    - name: ggrocer
      url-base: https://github.com/greengrocer98
    - name: crazy-keyboards
      url-base: https://github.com/crazy-keyboards
  projects:
    - name: zmk
      remote: zmkfirmware
      revision: main
      import: app/west.yml
    - name: zmk-vfx-indicator
      remote: ggrocer
      revision: main
    - name: zmk-locales
      remote: crazy-keyboards
      revision: develop
  self:
    path: config
```
